## dts/bindings/serial/nordic,nrf-uarte.yaml
```yaml
title: Nordic UARTE

description: >
    This binding gives a base representation of the Nordic UARTE

inherits:
    !include uart.yaml

properties:
    compatible:
      constraint: "nordic,nrf-uarte"

    reg:
      category: required

    interrupts:
      category: required

    tx-pin:
      type: int
      description: TX pin
      category: optional

    rx-pin:
      type: int
      description: RX pin
      category: optional

    rts-pin:
      type: int
      description: RTS pin
      category: optional

    cts-pin:
      type: int
      description: CTS pin
      category: optional
```
